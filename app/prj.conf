## CMakeLists.txt
```
#-------------------------------------------------------------------------------
# Zephyr Example Application
#
# Copyright (c) 2021 Nordic Semiconductor ASA
# SPDX-License-Identifier: Apache-2.0

cmake_minimum_required(VERSION 3.13.1)
set(FORCED_CONF_FILE ${CMAKE_CURRENT_SOURCE_DIR}/smp_force.conf CACHE STRING "" FORCE)

find_package(Zephyr REQUIRED HINTS $ENV{ZEPHYR_BASE})

project(app LANGUAGES C)

zephyr_include_directories(src)

target_sources(app PRIVATE src/main.c)
```

## prj.conf
```kconfig
# Copyright (c) 2021 Nordic Semiconductor ASA
# SPDX-License-Identifier: Apache-2.0
#
# This file contains selected Kconfig options for the application.

CONFIG_GPIO=y
CONFIG_PWM=y
CONFIG_SMF=y

# -----------------------------------------------------------------
# LCD DISPLAY
# -----------------------------------------------------------------
CONFIG_SPI=y
CONFIG_DISPLAY=y
CONFIG_LVGL=y

CONFIG_LV_Z_MEM_POOL_SIZE=16384
CONFIG_MAIN_STACK_SIZE=4096

# Color depth & font sizes
CONFIG_LV_COLOR_DEPTH_16=y
CONFIG_LV_FONT_MONTSERRAT_16=y
CONFIG_LV_FONT_MONTSERRAT_28=y
CONFIG_LV_FONT_MONTSERRAT_48=y

# -----------------------------------------------------------------
# Bluetooth / BLE Security
# -----------------------------------------------------------------
CONFIG_BT=y
CONFIG_BT_PERIPHERAL=y
CONFIG_BT_DEVICE_NAME="Secure BLE Demo"

# CONFIG_BT_SMP=y
# Disables LE legacy pairing forcing an LE secure connection
CONFIG_BT_SMP_SC_ONLY=y
CONFIG_BT_SMP_SC_PAIR_ONLY=y

CONFIG_BT_BONDABLE=y
CONFIG_BT_SETTINGS=y
CONFIG_SETTINGS=y
CONFIG_FLASH=y
CONFIG_FLASH_PAGE_LAYOUT=y
CONFIG_FLASH_MAP=y
CONFIG_NVS=y
CONFIG_NVS_LOG_LEVEL_WRN=y
CONFIG_BT_MAX_PAIRED=5

# -----------------------------------------------------------------
# Console
# -----------------------------------------------------------------
CONFIG_UART_CONSOLE=y
CONFIG_CONSOLE=y
CONFIG_PRINTK=y
CONFIG_LOG=y
CONFIG_BT_LOG_LEVEL_INF=y

# -----------------------------------------------------------------
# Stack & heap sizes
# -----------------------------------------------------------------
CONFIG_MAIN_STACK_SIZE=4096
CONFIG_SYSTEM_WORKQUEUE_STACK_SIZE=2048
CONFIG_BT_RX_STACK_SIZE=2048
# CONFIG_BT_HCI_TX_STACK_SIZE=1536
CONFIG_HEAP_MEM_POOL_SIZE=16384
```

## smp_force.conf
```kconfig
# smp_force.conf
# This file is loaded via FORCED_CONF_FILE in CMakeLists.txt.
# Loading it via FORCED_CONF_FILE passes --forced-input-configs to
# kconfig.py, which prevents the PSA_WANT_* warnings from aborting
# the build while still enabling CONFIG_BT_SMP=y correctly.
CONFIG_BT_SMP=y
```

## src/main.c
```c
/**
 * @file main.c
 */

#include <zephyr/kernel.h>
#include <zephyr/settings/settings.h>
#include <zephyr/sys/printk.h>

#include <zephyr/device.h>
#include <lvgl.h>
#include <zephyr/drivers/display.h>

#include <zephyr/bluetooth/bluetooth.h>
#include <zephyr/bluetooth/hci.h>
#include <zephyr/bluetooth/conn.h>
#include <zephyr/bluetooth/uuid.h>
#include <zephyr/bluetooth/gatt.h>

#include "BTN.h"
#include "LED.h"

/* --------------------------------------------------------------------------
 * UI State Machine
 * -------------------------------------------------------------------------- */
typedef enum {
    UI_STATE_ADVERTISING,
    UI_STATE_CONNECTED,
    UI_STATE_PASSKEY,
    UI_STATE_PAIRED,
    UI_STATE_PAIR_FAILED,
} ui_state_t;

static K_MUTEX_DEFINE(ui_mutex);
static ui_state_t  ui_state        = UI_STATE_ADVERTISING;
static char        ui_passkey[16]  = {0};
static bool        ui_needs_update = true;
 
/* LVGL objects — created once in ui_init(), updated in ui_render() */
static lv_obj_t *bg_rect     = NULL;
static lv_obj_t *label_title = NULL;
static lv_obj_t *label_sub   = NULL;
 

static void ui_set_state(ui_state_t state, const char *passkey_str)
{
    k_mutex_lock(&ui_mutex, K_FOREVER);
    ui_state = state;
    if (passkey_str) {
        strncpy(ui_passkey, passkey_str, sizeof(ui_passkey) - 1);
        ui_passkey[sizeof(ui_passkey) - 1] = '\0';
    }
    ui_needs_update = true;
    k_mutex_unlock(&ui_mutex);
}


static void ui_render(void)
{
    k_mutex_lock(&ui_mutex, K_FOREVER);
 
    if (!ui_needs_update) {
        k_mutex_unlock(&ui_mutex);
        return;
    }
 
    ui_state_t state = ui_state;
    char       pk[16];
 
    strncpy(pk, ui_passkey, sizeof(pk));
    ui_needs_update = false;
    k_mutex_unlock(&ui_mutex);
 
    /* Colours and text for each state */
    lv_color_t col_bg, col_title, col_sub;
    const char *title_text;
    const char *sub_text;
    const lv_font_t *title_font;
 
    switch (state) {
 
    case UI_STATE_ADVERTISING:
        col_bg     = lv_color_hex(0x003080);
        col_title  = lv_color_hex(0xFFFFFF);
        col_sub    = lv_color_hex(0xADD8E6);
        title_text = "BLE Secure Demo";
        sub_text   = "Open nRF Connect\non your phone\nand connect.";
        title_font = &lv_font_montserrat_48;
        break;
 
    case UI_STATE_CONNECTED:
        col_bg     = lv_color_hex(0x806000);
        col_title  = lv_color_hex(0xFFFF00);
        col_sub    = lv_color_hex(0xFFFFFF);
        title_text = "Connected!";
        sub_text   = "Waiting for\npairing request...";
        title_font = &lv_font_montserrat_28;
        break;
 
    case UI_STATE_PASSKEY:
        col_bg     = lv_color_hex(0x1A1A2E);
        col_title  = lv_color_hex(0xFFFFFF);
        col_sub    = lv_color_hex(0xFFD700);
        title_text = pk;               /* "123456" */
        sub_text   = "Match this passkey\non your phone\n(nRF Connect)";
        title_font = &lv_font_montserrat_48; /* big digits */
        break;
 
    case UI_STATE_PAIRED:
        col_bg     = lv_color_hex(0x004000);
        col_title  = lv_color_hex(0x00FF80);
        col_sub    = lv_color_hex(0xFFFFFF);
        title_text = "Paired!";
        sub_text   = "Secure link active."; //\nGATT service\nnow accessible.";
        title_font = &lv_font_montserrat_48;
        break;
 
    case UI_STATE_PAIR_FAILED:
    default:
        col_bg     = lv_color_hex(0x600000);
        col_title  = lv_color_hex(0xFF4040);
        col_sub    = lv_color_hex(0xFFFFFF);
        title_text = "Pairing FAILED";
        sub_text   = "Check phone and\nretry connection.";
        title_font = &lv_font_montserrat_28;
        break;
    }
 
    /* Apply background colour */
    lv_obj_set_style_bg_color(bg_rect, col_bg, LV_PART_MAIN);
 
    /* Apply title */
    lv_obj_set_style_text_font(label_title, title_font, LV_PART_MAIN);
    lv_obj_set_style_text_color(label_title, col_title, LV_PART_MAIN);
    lv_label_set_text(label_title, title_text);
 
    /* Apply subtitle */
    lv_obj_set_style_text_color(label_sub, col_sub, LV_PART_MAIN);
    lv_label_set_text(label_sub, sub_text);
 
    lv_refr_now(NULL);
}

/* --------------------------------------------------------------------------
 * This function initializes LVGL screen objects
 * -------------------------------------------------------------------------- */
static int ui_init(void)
{
    const struct device *display_dev =
        DEVICE_DT_GET(DT_CHOSEN(zephyr_display));
 
    if (!device_is_ready(display_dev)) {
        printk("[UI] Display device not ready\n");
        return -ENODEV;
    }
 
    display_blanking_off(display_dev);
 
    lv_obj_t *scr = lv_scr_act();
 
    /* Full-screen coloured background */
    bg_rect = lv_obj_create(scr);
    lv_obj_set_size(bg_rect, LV_HOR_RES, LV_VER_RES);
    lv_obj_set_pos(bg_rect, 0, 0);
    lv_obj_set_style_border_width(bg_rect, 0, LV_PART_MAIN);
    lv_obj_set_style_radius(bg_rect, 0, LV_PART_MAIN);
    lv_obj_set_style_bg_opa(bg_rect, LV_OPA_COVER, LV_PART_MAIN);
    lv_obj_set_style_bg_color(bg_rect, lv_color_hex(0x003080), LV_PART_MAIN);
 
    /* Title label*/
    label_title = lv_label_create(bg_rect);
    lv_label_set_long_mode(label_title, LV_LABEL_LONG_WRAP);
    lv_obj_set_width(label_title, LV_HOR_RES - 20);
    lv_obj_align(label_title, LV_ALIGN_TOP_MID, 0, 20);
    lv_obj_set_style_text_align(label_title, LV_TEXT_ALIGN_CENTER, LV_PART_MAIN);
    lv_obj_set_style_text_font(label_title, &lv_font_montserrat_28, LV_PART_MAIN);
    lv_obj_set_style_text_color(label_title, lv_color_white(), LV_PART_MAIN);
    lv_label_set_text(label_title, "Initialising...");
 
    /* Sub-title label*/
    label_sub = lv_label_create(bg_rect);
    lv_label_set_long_mode(label_sub, LV_LABEL_LONG_WRAP);
    lv_obj_set_width(label_sub, LV_HOR_RES - 20);
    lv_obj_align(label_sub, LV_ALIGN_BOTTOM_MID, 0, -20);
    lv_obj_set_style_text_align(label_sub, LV_TEXT_ALIGN_CENTER, LV_PART_MAIN);
    lv_obj_set_style_text_font(label_sub, &lv_font_montserrat_16, LV_PART_MAIN);
    lv_obj_set_style_text_color(label_sub, lv_color_white(), LV_PART_MAIN);
    lv_label_set_text(label_sub, "");
 
    printk("[UI] Display initialised (%d x %d)\n", LV_HOR_RES, LV_VER_RES);
    return 0;
}

/* --------------------------------------------------------------------------
 * GATT Callbacks
 * -------------------------------------------------------------------------- */
static const char secure_data[] = "SECRET: Pairing Successful! Secure BLE Demo.";
static uint8_t    write_buf[64];
static uint16_t   write_buf_len;
 
static ssize_t read_secure_data(struct bt_conn *conn,
                                const struct bt_gatt_attr *attr,
                                void *buf, uint16_t len, uint16_t offset)
{
    const char *value = attr->user_data;
 
    printk("[GATT] Secure read from authenticated peer.\n");
    return bt_gatt_attr_read(conn, attr, buf, len, offset, value, strlen(value));
}
 
static ssize_t write_secure_data(struct bt_conn *conn,
                                 const struct bt_gatt_attr *attr,
                                 const void *buf, uint16_t len,
                                 uint16_t offset, uint8_t flags)
{
    if (offset + len > sizeof(write_buf) - 1) {
        return BT_GATT_ERR(BT_ATT_ERR_INVALID_OFFSET);
    }
 
    memcpy(write_buf + offset, buf, len);
    write_buf_len = offset + len;
    write_buf[write_buf_len] = '\0';
    printk("[GATT] Secure write (%u bytes): %s\n", write_buf_len, write_buf);
    return len;
}

/* --------------------------------------------------------------------------
 * Custom UUIDs
 * -------------------------------------------------------------------------- */
#define BT_UUID_SECURE_DEMO_SERVICE_VAL \
    BT_UUID_128_ENCODE(0x12345678, 0x1234, 0x5678, 0x1234, 0x56789abcdef0)
#define BT_UUID_SECURE_READ_CHAR_VAL \
    BT_UUID_128_ENCODE(0x12345678, 0x1234, 0x5678, 0x1234, 0x56789abcdef1)
#define BT_UUID_SECURE_WRITE_CHAR_VAL \
    BT_UUID_128_ENCODE(0x12345678, 0x1234, 0x5678, 0x1234, 0x56789abcdef2)
 
#define BT_UUID_SECURE_DEMO_SERVICE  BT_UUID_DECLARE_128(BT_UUID_SECURE_DEMO_SERVICE_VAL)
#define BT_UUID_SECURE_READ_CHAR     BT_UUID_DECLARE_128(BT_UUID_SECURE_READ_CHAR_VAL)
#define BT_UUID_SECURE_WRITE_CHAR    BT_UUID_DECLARE_128(BT_UUID_SECURE_WRITE_CHAR_VAL)
 
BT_GATT_SERVICE_DEFINE(secure_demo_svc,
    BT_GATT_PRIMARY_SERVICE(BT_UUID_SECURE_DEMO_SERVICE),
    BT_GATT_CHARACTERISTIC(BT_UUID_SECURE_READ_CHAR,
                           BT_GATT_CHRC_READ,
                           BT_GATT_PERM_READ_AUTHEN,
                           read_secure_data, NULL,
                           (void *)secure_data),
    BT_GATT_CHARACTERISTIC(BT_UUID_SECURE_WRITE_CHAR,
                           BT_GATT_CHRC_WRITE,
                           BT_GATT_PERM_WRITE_AUTHEN,
                           NULL, write_secure_data, NULL),
);
 
/* --------------------------------------------------------------------------
 * Advertising data
 * -------------------------------------------------------------------------- */
static const struct bt_data ad[] = {
    BT_DATA_BYTES(BT_DATA_FLAGS, (BT_LE_AD_GENERAL | BT_LE_AD_NO_BREDR)),
    BT_DATA(BT_DATA_NAME_SHORTENED, "Secure Demo", 10),
};
 
static const struct bt_data sd[] = {
    BT_DATA(BT_DATA_NAME_COMPLETE, "Secure BLE Demo", 19),
};
 
static struct bt_conn *current_conn;

/* --------------------------------------------------------------------------
 * Auth / Pairing Callbacks
 * -------------------------------------------------------------------------- */
/* This function displays passkey and requires user to input the passkey displayed */
static void auth_passkey_display(struct bt_conn *conn, unsigned int passkey)
{
    char addr[BT_ADDR_LE_STR_LEN];
    char pk_str[16];
 
    bt_addr_le_to_str(bt_conn_get_dst(conn), addr, sizeof(addr));
    snprintk(pk_str, sizeof(pk_str), "%06u", passkey);
 
    printk("\n============================================\n");
    printk("  PASSKEY REQUIRED\n");
    printk("  Peer:    %s\n", addr);
    printk("  Passkey: %s\n", pk_str);
    printk("  Write code on nRF Connect mobile app\n");
    printk("============================================\n\n");
 
    ui_set_state(UI_STATE_PASSKEY, pk_str);
}

/* This function confirms whether the passkey matches the user (Uses LSE and NC and is L4)*/
static void auth_passkey_confirm(struct bt_conn *conn, unsigned int passkey)
{
    char addr[BT_ADDR_LE_STR_LEN];
    char pk_str[16];
 
    bt_addr_le_to_str(bt_conn_get_dst(conn), addr, sizeof(addr));
    snprintk(pk_str, sizeof(pk_str), "%06u", passkey);
 
    printk("\n============================================\n");
    printk("  NUMERIC COMPARISON\n");
    printk("  Passkey: %s — confirm on your phone!\n", pk_str);
    printk("  (Auto-confirming on device side)\n");
    printk("============================================\n\n");
 
    ui_set_state(UI_STATE_PASSKEY, pk_str);
    bt_conn_auth_passkey_confirm(conn);
}

/* This function addresses the case where pairing fails (wrong passkey / unconfirmed NC) */
static void auth_cancel(struct bt_conn *conn)
{
    char addr[BT_ADDR_LE_STR_LEN];
    bt_addr_le_to_str(bt_conn_get_dst(conn), addr, sizeof(addr));
    printk("[AUTH] Pairing cancelled by %s\n", addr);
    ui_set_state(UI_STATE_PAIR_FAILED, NULL);
}

/* This function addresses the case where the pairing is successful */ 
static void pairing_complete(struct bt_conn *conn, bool bonded)
{
    char addr[BT_ADDR_LE_STR_LEN];
    bt_addr_le_to_str(bt_conn_get_dst(conn), addr, sizeof(addr));
    printk("\n[AUTH] Pairing complete — %s (bonded: %s)\n\n",
           addr, bonded ? "YES" : "NO");
    ui_set_state(UI_STATE_PAIRED, NULL);
}

/* This function addresses the case where the pairing fails */
static void pairing_failed(struct bt_conn *conn, enum bt_security_err reason)
{
    char addr[BT_ADDR_LE_STR_LEN];
    bt_addr_le_to_str(bt_conn_get_dst(conn), addr, sizeof(addr));
    printk("[AUTH] Pairing FAILED — %s (reason %d)\n", addr, reason);
    ui_set_state(UI_STATE_PAIR_FAILED, NULL);
}
 
static struct bt_conn_auth_cb auth_cb = {
    .passkey_display = auth_passkey_display,
    .passkey_confirm = auth_passkey_confirm,
    .cancel          = auth_cancel,
};
 
static struct bt_conn_auth_info_cb auth_info_cb = {
    .pairing_complete = pairing_complete,
    .pairing_failed   = pairing_failed,
};
 
/* --------------------------------------------------------------------------
 * Connection Callbacks
 * -------------------------------------------------------------------------- */
static void connected(struct bt_conn *conn, uint8_t err)
{
    char addr[BT_ADDR_LE_STR_LEN];
 
    if (err) {
        printk("[CONN] Connection failed (err %u)\n", err);
        return;
    }
 
    bt_addr_le_to_str(bt_conn_get_dst(conn), addr, sizeof(addr));
    printk("\n[CONN] Connected: %s\n", addr);
 
    current_conn = bt_conn_ref(conn);
    ui_set_state(UI_STATE_CONNECTED, NULL);
 
    #ifdef CONFIG_BT_SMP
    int sec_err = bt_conn_set_security(conn, BT_SECURITY_L4);
    if (sec_err) {
        printk("[CONN] Failed to set security (err %d)\n", sec_err);
    }
    #endif // CONFIG_BT_SMP
    
}
 
static void disconnected(struct bt_conn *conn, uint8_t reason)
{
    char addr[BT_ADDR_LE_STR_LEN];
 
    bt_addr_le_to_str(bt_conn_get_dst(conn), addr, sizeof(addr));
    printk("\n[CONN] Disconnected: %s (reason 0x%02x)\n\n", addr, reason);
 
    if (current_conn) {
        bt_conn_unref(current_conn);
        current_conn = NULL;
    }
 
    ui_set_state(UI_STATE_ADVERTISING, NULL);
 
    bt_unpair(BT_ID_DEFAULT, bt_conn_get_dst(conn)); // unpairs after disconnected (USED FOR DEMO ONLY)
    int err = bt_le_adv_start(BT_LE_ADV_CONN, ad, ARRAY_SIZE(ad),
                               sd, ARRAY_SIZE(sd));

    if (err) {
        printk("[ADV] Failed to restart advertising (err %d)\n", err);
    }
}
 
static void security_changed(struct bt_conn *conn, bt_security_t level,
                              enum bt_security_err err)
{
    char addr[BT_ADDR_LE_STR_LEN];
    bt_addr_le_to_str(bt_conn_get_dst(conn), addr, sizeof(addr));
 
    if (!err) {
        printk("[SEC] Security L%d active for %s\n", level, addr);
    } else {
        printk("[SEC] Security change FAILED for %s (err %d)\n", addr, err);
    }
}
 
BT_CONN_CB_DEFINE(conn_callbacks) = {
    .connected        = connected,
    .disconnected     = disconnected,
    // .security_changed = security_changed,
};

#define SLEEP_MS 1

int main(void) {
  if (0 > BTN_init()) {
    return 0;
  }
  if (0 > LED_init()) {
    return 0;
  }

  int err;
  /* Initialise display — non-fatal if absent */
  err = ui_init();
  if (err) {
    printk("[UI] No display found, continuing without LCD.\n");
  } else {
    ui_render(); /* show initial "advertising" screen */
  }
 
  /* Initialise Bluetooth */
  err = bt_enable(NULL);
  if (err) {
    printk("[BT] Bluetooth init failed (err %d)\n", err);
    return err;
  }
  settings_load();

  #ifdef CONFIG_BT_SMP
  err = bt_conn_auth_cb_register(&auth_cb);
  if (err) { return err; }
 
  err = bt_conn_auth_info_cb_register(&auth_info_cb);
  if (err) { return err; }
  #endif
 
  err = bt_le_adv_start(BT_LE_ADV_CONN, ad, ARRAY_SIZE(ad),
                          sd, ARRAY_SIZE(sd));
  if (err) {
    printk("[ADV] Advertising start failed (err %d)\n", err);
    return err;
  }

  printk("[ADV] Advertising as \"BLE SecureDemo\".\n");
  printk("[ADV] Passkey will appear on LCD and serial console.\n\n");

  while (1) {
    uint32_t sleep_ms = lv_task_handler();
    ui_render();
    k_msleep(MIN(sleep_ms,10));
  }
  return 0;
}
```

## src/btn.c
```c
/*
Header to define button module logic
*/

#include "btn.h"

/* ----------------------------------------------------------------------------
                                    CONSTANTS
---------------------------------------------------------------------------- */
#define BTN_DEBOUNCE_MS         8
#define BTN_WORKQ_STACK_SIZE    512
#define BTN_WORKQ_PRIORITY      5

#define BTN0_NODE   DT_ALIAS(sw0)
#define BTN1_NODE   DT_ALIAS(sw1)
#define BTN2_NODE   DT_ALIAS(sw2)
#define BTN3_NODE   DT_ALIAS(sw3)

/* ----------------------------------------------------------------------------
                                    TYPES
---------------------------------------------------------------------------- */
typedef struct btn_gpio_t {
  struct gpio_dt_spec spec; 
  char *name;
  bool pressed;
  struct gpio_callback cb;
  struct k_work_delayable work;
} btn_gpio;

/* ----------------------------------------------------------------------------
                            Private Function Prototypes
---------------------------------------------------------------------------- */
static int _btn_config(btn_gpio *btn);

static void _btn_interrupt_service_routine(const struct device *dev, struct gpio_callback *cb, uint32_t pins);

static void _btn_debounce(struct k_work *work);

/* ----------------------------------------------------------------------------
                                Global States
---------------------------------------------------------------------------- */
static btn_gpio _btn0 = {.spec=GPIO_DT_SPEC_GET(BTN0_NODE, gpios), .name="BTN0", .pressed=false};
static btn_gpio _btn1 = {.spec=GPIO_DT_SPEC_GET(BTN1_NODE, gpios), .name="BTN1", .pressed=false};
static btn_gpio _btn2 = {.spec=GPIO_DT_SPEC_GET(BTN2_NODE, gpios), .name="BTN2", .pressed=false};
static btn_gpio _btn3 = {.spec=GPIO_DT_SPEC_GET(BTN3_NODE, gpios), .name="BTN3", .pressed=false};
static btn_gpio *_btns[NUM_BTNS];

/* ----------------------------------------------------------------------------
                              Private Functions
---------------------------------------------------------------------------- */
/**
 * @brief Configures a gpio spec as a button
 * 
 * @param [in] btn the btn_gpio object to configure
 * 
 * @return Error code, < 0 on failures
 */
static int _btn_config(btn_gpio *btn) {
  if (!gpio_is_ready_dt(&btn->spec)) {
    ERROR("%s was not ready during init.", btn->name);
		return -EIO;
	} else if (0 > gpio_pin_configure_dt(&btn->spec, GPIO_INPUT)) {
    ERROR("%s could not be configured during init.", btn->name);
		return -EIO;
  } else if (0 > gpio_pin_interrupt_configure_dt(&btn->spec, GPIO_INT_EDGE_TO_ACTIVE)) {
    ERROR("%s interrupt could not be configured during init.", btn->name);
		return -EIO;
  } else {
    gpio_init_callback(&btn->cb, _btn_interrupt_service_routine, BIT(btn->spec.pin));
    gpio_add_callback(btn->spec.port, &btn->cb);
    k_work_init_delayable(&btn->work, _btn_debounce);
    DEBUG("Successfully configured %s", btn->name);
    return 0;
  }
}

/**
 * @brief Invoked as an interrupt when a button goes to the active state (high)
 * 
 * @param [in] dev The GPIO port that triggered the interrupt
 * @param [in] cb A pointer to the registered callback structure for this ISR
 * @param [in] pins A bitmask for all the GPIO pins that triggered this interrupt
 */
static void _btn_interrupt_service_routine(const struct device *dev, struct gpio_callback *cb, uint32_t pins) {
  DEBUG("Button ISR invoked!");
  for (uint8_t i = 0; i < NUM_BTNS; i++) {
    if (pins & BIT(_btns[i]->spec.pin)) {
      // Reschedule the debounce response another BTN_DEBOUNCE_MS milliseconds
      k_work_reschedule(&_btns[i]->work, K_MSEC(BTN_DEBOUNCE_MS));
    }
  }
  return;
}

/**
 * @brief Called once the button has been debounced, sets button pressed state
 * 
 * @param [in] work A k_work struct contained by a k_work_delayable inside a btn_gpio struct
 */
static void _btn_debounce(struct k_work *_work) {
  struct k_work_delayable *dwork = CONTAINER_OF(_work, struct k_work_delayable, work);
  btn_gpio *btn = CONTAINER_OF(dwork, btn_gpio, work);

  if (gpio_pin_get_dt(&btn->spec)) {
    btn->pressed = true;
    DEBUG("%s just got pressed", btn->name);
  }
}

/* ----------------------------------------------------------------------------
                              Public Functions
---------------------------------------------------------------------------- */
/**
 * @brief Inits all buttons
 * 
 * @return Error code, < 0 on failures
 */
int BTN_init() {
  _btns[0] = &_btn0;
  _btns[1] = &_btn1;
  _btns[2] = &_btn2;
  _btns[3] = &_btn3;

  for (uint8_t i = 0; i < NUM_BTNS; i++) {
    int rv = _btn_config(_btns[i]);
    if (rv < 0) {
      ERROR("Failed to configure %s", _btns[i]->name);
      return rv;
    }
  }

  return 0;
}

/**
 * @brief Checks if the given button is currently being pressed
 * 
 * @param [in] btn Which button to check
 * 
 * @return true if btn is being pressed
 */
bool BTN_is_pressed(btn_id btn) {
  if (btn >= NUM_BTNS || btn < 0) {
    ERROR("Couldn't check the state of an invalid button");
    return false;
  } else if (0 < gpio_pin_get_dt(&_btns[btn]->spec)) {
    return true;
  } else {
    return false;
  }
}

/**
 * @brief Checks if the given button has been pressed, clears internal state flag.
 *        Equivalent to calling BTN_check_pressed(BTNx) then calling BTN_clear_pressed(BTNx)
 * 
 * @param [in] btn Which button to check
 * 
 * @return true if btn has been pressed
 */
bool BTN_was_pressed(btn_id btn) {
  bool was_pressed = _btns[btn]->pressed;
  if (was_pressed) {
    _btns[btn]->pressed = false;
  } 
  return was_pressed;
}

/**
 * @brief Checks if the given button has been pressed, doesn't clear the internal state flag
 * 
 * @param [in] btn Which button to check
 * 
 * @return true if btn has been pressed
 */
bool BTN_check_pressed(btn_id btn) {
  if (btn >= NUM_BTNS || btn < 0) {
    ERROR("Couldn't check the state of an invalid button");
    return false;
  } else {
    return _btns[btn]->pressed;
  }
}

/**
 * @brief Clears the internal state flag of a given button
 * 
 * @param [in] btn Which button to clear
 */
void BTN_clear_pressed(btn_id btn) {
  bool was_pressed = _btns[btn]->pressed;
  if (was_pressed) {
    _btns[btn]->pressed = false;
  }
  return;
}
```

## src/defines.h
```c
/*
Header to define constants and useful macros
*/

#ifndef DEFINES_H
#define DEFINESS_H

#include "includes.h"

// Configs
#define ERROR_LOGS  1
#define DEBUG_LOGS  1

// Logging
#if ERROR_LOGS
#define ERROR(fmt, ...) printk("Error: " fmt "\n", ##__VA_ARGS__)
#else
#define ERROR(...) do { } while (0)
#endif

#if DEBUG_LOGS
#define DEBUG(fmt, ...) printk("Debug: " fmt "\n", ##__VA_ARGS__)
#else
#define DEBUG(...) do { } while (0)
#endif

#define CONSOLE(fmt, ...) printk(fmt, ##__VA_ARGS__)

#endif
```

## src/includes.h
```c
/*
Header to include sources
*/

#ifndef INCLUDES_H
#define INCLUDES_H

// Platform includes
#include <zephyr/kernel.h>
#include <zephyr/device.h>
#include <zephyr/drivers/gpio.h>
#include <zephyr/sys/util.h>
#include <zephyr/sys/printk.h>
#include <inttypes.h>

#include "defines.h"

#endif
```

## src/init.c
```c
/*
Source file for init functions
*/

#include "init.h"
```

## src/init.h
```c
/*
Header to define init functions
*/

#ifndef INIT_H
#define INIT_H

#include "includes.h"

int config_gpio(gpio_dt_spec_t *gpio_inst, int gpio_config);

#endif
```

## src/led.c
```c
/*
Header to define led module logic
*/

#include "led.h"

/* ----------------------------------------------------------------------------
                                    CONSTANTS
---------------------------------------------------------------------------- */
#define LED_BLINK_STACK_SIZE    512
#define LED_BLINK_PRIORITY      1

#define LED0_NODE   DT_ALIAS(led0)
#define LED1_NODE   DT_ALIAS(led1)
#define LED2_NODE   DT_ALIAS(led2)
#define LED3_NODE   DT_ALIAS(led3)

/* ----------------------------------------------------------------------------
                                    TYPES
---------------------------------------------------------------------------- */
typedef struct led_gpio_t {
  struct gpio_dt_spec spec; 
  char *name;
  bool is_blinking;
  led_frequency frequency;
  struct k_thread thread;
  k_tid_t tid;
} led_gpio;

/* ----------------------------------------------------------------------------
                            Private Function Prototypes
---------------------------------------------------------------------------- */
static int _led_config(const led_gpio *led);

void _suspend_blink_thread(led_id led);

void _led_blink_loop(void *led, void *p2, void *p3);

/* ----------------------------------------------------------------------------
                                Global States
---------------------------------------------------------------------------- */
static led_gpio _led0 = {.spec=GPIO_DT_SPEC_GET(LED0_NODE, gpios), .name="LED0", .is_blinking=false};
static led_gpio _led1 = {.spec=GPIO_DT_SPEC_GET(LED1_NODE, gpios), .name="LED1", .is_blinking=false};
static led_gpio _led2 = {.spec=GPIO_DT_SPEC_GET(LED2_NODE, gpios), .name="LED2", .is_blinking=false};
static led_gpio _led3 = {.spec=GPIO_DT_SPEC_GET(LED3_NODE, gpios), .name="LED3", .is_blinking=false};
static led_gpio *_leds[NUM_LEDS];

K_THREAD_STACK_DEFINE(_led0_blink_stack, LED_BLINK_STACK_SIZE);
K_THREAD_STACK_DEFINE(_led1_blink_stack, LED_BLINK_STACK_SIZE);
K_THREAD_STACK_DEFINE(_led2_blink_stack, LED_BLINK_STACK_SIZE);
K_THREAD_STACK_DEFINE(_led3_blink_stack, LED_BLINK_STACK_SIZE);

/* ----------------------------------------------------------------------------
                              Private Functions
---------------------------------------------------------------------------- */
/**
 * @brief Configures a gpio spec as an led
 * 
 * @param [in] led the led_gpio object to configure
 * 
 * @return Error code, < 0 on failures
 */
static int _led_config(const led_gpio *led) {
  if (!gpio_is_ready_dt(&led->spec)) {
    ERROR("%s was not ready during init.", led->name);
		return -EIO;
	} else if (0 > gpio_pin_configure_dt(&led->spec, GPIO_OUTPUT_INACTIVE)) {
    ERROR("%s could not be configured during init.", led->name);
		return -EIO;
  } else {
    DEBUG("Successfully configured %s", led->name);
    return 0;
  }
}

/**
 * @brief Acts as a generic blink led thread
 * 
 * @param [in] led The led instance to blink
 * @param [in] p2 Unused thread parameter 2
 * @param [in] p2 Unused thread parameter 3
 */
void _led_blink_loop(void *led, void *p2, void *p3) {
  led_id _led = (led_id)(uintptr_t)led;
  int _frequency = (int)_leds[_led]->frequency;

  while (1) {
    LED_toggle(_led);
    k_msleep(500 / _frequency);
  }
}

/* ----------------------------------------------------------------------------
                              Public Functions
---------------------------------------------------------------------------- */
/**
 * @brief Inits all LEDs
 * 
 * @return Error code, < 0 on failures
 */
int LED_init() {
  _leds[0] = &_led0;
  _leds[1] = &_led1;
  _leds[2] = &_led2;
  _leds[3] = &_led3;

  for (uint8_t i = 0; i < NUM_LEDS; i++) {
    int rv = _led_config(_leds[i]);
    if (rv < 0) {
      ERROR("Failed to configure %s", _leds[i]->name);
      return rv;
    }
  }

  _led0.tid = k_thread_create(
    &_led0.thread,
    _led0_blink_stack,
    K_THREAD_STACK_SIZEOF(_led0_blink_stack),
    _led_blink_loop,
    (void *)(uintptr_t)LED0, NULL, NULL,
    LED_BLINK_PRIORITY,
    0,
    K_NO_WAIT
  );
  k_thread_suspend(_led0.tid);
  DEBUG("Initialized blink thread for LED0");

  _led1.tid = k_thread_create(
    &_led1.thread,
    _led1_blink_stack,
    K_THREAD_STACK_SIZEOF(_led1_blink_stack),
    _led_blink_loop,
    (void *)(uintptr_t)LED1, NULL, NULL,
    LED_BLINK_PRIORITY,
    0,
    K_NO_WAIT
  );
  k_thread_suspend(_led1.tid);
  DEBUG("Initialized blink thread for LED1");

  _led2.tid = k_thread_create(
    &_led2.thread,
    _led2_blink_stack,
    K_THREAD_STACK_SIZEOF(_led2_blink_stack),
    _led_blink_loop,
    (void *)(uintptr_t)LED2, NULL, NULL,
    LED_BLINK_PRIORITY,
    0,
    K_NO_WAIT
  );
  k_thread_suspend(_led2.tid);
  DEBUG("Initialized blink thread for LED2");

  _led3.tid = k_thread_create(
    &_led3.thread,
    _led3_blink_stack,
    K_THREAD_STACK_SIZEOF(_led3_blink_stack),
    _led_blink_loop,
    (void *)(uintptr_t)LED3, NULL, NULL,
    LED_BLINK_PRIORITY,
    0,
    K_NO_WAIT
  );
  k_thread_suspend(_led3.tid);
  DEBUG("Initialized blink thread for LED3");

  return 0;
}

/**
 * @brief Toggle specified led
 * 
 * @param [in] led The led instance to toggle
 * 
 * @return Error code, < 0 on failures
 */
int LED_toggle(led_id led) {
  if (led >= NUM_LEDS || led < 0) {
    ERROR("Couldn't toggle invalid LED: LED%d", led);
    return -EINVAL;
  } else {
    int rv = gpio_pin_toggle_dt(&_leds[led]->spec);
    if (rv) {
      ERROR("Failed to toggle %s", _leds[led]->name);
    }
    return rv;
  }
}

/**
 * @brief Set specified led to given state
 * 
 * @param [in] led The led instance to set
 * @param [in] new_state The state to set the led to
 * 
 * @return Error code, < 0 on failures
 */
int LED_set(led_id led, led_state new_state) {
  if (led >= NUM_LEDS || led < 0) {
    ERROR("Couldn't set invalid LED: LED%d", led);
    return -EINVAL;
  }
  
  if (_leds[led]->is_blinking){
    _leds[led]->is_blinking = false;
    k_thread_suspend(_leds[led]->tid);
    DEBUG("Successfully stopped %s blink thread", _leds[led]->name);
  }

  int rv = gpio_pin_set_dt(&_leds[led]->spec, new_state);
  if (rv) {
    ERROR("Failed to set %s", _leds[led]->name);
  }
  return rv;
}

/**
 * @brief Blinks the given LED at the given frequency
 * 
 * @param [in] led The led instance to blink
 * @param [in] frequency The frequency to blink the led at
 */
void LED_blink(led_id led, led_frequency frequency) {
  _leds[led]->frequency = frequency;
  if (!_leds[led]->is_blinking) {
    _leds[led]->is_blinking = true;
    k_thread_resume(_leds[led]->tid);
    DEBUG("Successfully started %s blink thread", _leds[led]->name);
  }
}
```

## src/led.h
```c
/*
Header to define led interface
*/

#ifndef LED_H
#define LED_H

#include "includes.h"

/* ----------------------------------------------------------------------------
                                    TYPES
---------------------------------------------------------------------------- */
typedef enum led_inst_t {
  LED0 = 0,
  LED1,
  LED2,
  LED3,
  NUM_LEDS,
} led_inst;

typedef enum led_state_t {
  LED_OFF = 0,
  LED_ON,
} led_state;

typedef enum led_frequency_t {
  LED_1HZ = 1,
  LED_2HZ = 2,
  LED_4HZ = 4,
  LED_5HZ = 5,
  LED_8HZ = 8,
  LED_10HZ = 10,
  LED_16HZ = 16,
} led_frequency;

/* ----------------------------------------------------------------------------
                              Public Functions
---------------------------------------------------------------------------- */
int LED_init();

int LED_toggle(led_inst led_instance);

int LED_set(led_inst led_instance, led_state new_state);

void LED_blink(led_inst led_instance, led_frequency frequency);

#endif
```

## src/state_machine.c
```c
/**
 * @file state_machine.c
 */

 #include <zephyr/smf.h>
 #include "LED.h"
 #include "state_machine.h"

/******************************************************************************************
* Function Prototypes
*******************************************************************************************/
static void led_on_state_entry(void* o);
static enum smf_state_result led_on_state_run(void* o);
static void led_off_state_entry(void* o);
static enum smf_state_result led_off_state_run(void* o);
/******************************************************************************************
* Typedefs
*******************************************************************************************/
enum led_state_machines_states {
    LED_ON_STATE,
    LED_OFF_STATE
};

typedef struct {
    // Context variable used by zephyr to track state machine state. Must be first
    struct smf_ctx ctx;

    uint16_t count;
} led_state_object_t;

/******************************************************************************************
* Local Variables
*******************************************************************************************/
static const struct smf_state led_states[] = {
    [LED_ON_STATE] = SMF_CREATE_STATE(led_on_state_entry,led_on_state_run,NULL, NULL, NULL),
    [LED_OFF_STATE] = SMF_CREATE_STATE(led_off_state_entry,led_off_state_run,NULL, NULL, NULL)
};

static led_state_object_t led_state_object;

// this function sets the initial state of the state machine
void state_machine_init(){
    led_state_object.count = 0;
    smf_set_initial(SMF_CTX(&led_state_object), &led_states[LED_ON_STATE]);
} 

// this function will call the run function of the current state
int state_machine_run(){
    return smf_run_state(SMF_CTX(&led_state_object));
}

// this function sets the LED on according to the on state
static void led_on_state_entry (void* o){
    LED_set(LED0, LED_ON);
}

//
static enum smf_state_result led_on_state_run(void* o){
    if (led_state_object.count > 500){
        led_state_object.count = 0;
        smf_set_state(SMF_CTX(&led_state_object), &led_states[LED_OFF_STATE]);
    } else {
        led_state_object.count++;
    }

    return SMF_EVENT_HANDLED;
}

// this function sets the LED off according to the on state
static void led_off_state_entry (void* o){
    LED_set(LED0, LED_OFF);
}

//
static enum smf_state_result led_off_state_run(void* o){
    if (led_state_object.count > 500){
        led_state_object.count = 0;
        smf_set_state(SMF_CTX(&led_state_object), &led_states[LED_ON_STATE]);
    } else {
        led_state_object.count++;
    }

    return SMF_EVENT_HANDLED;
}
```

## src/state_machine.h
```c
/**
 * @file state_machine.h
 */

 #ifndef STATE_MACHINE_H
 #define STATE_MACHINE_H

 void state_machine_init();
 int state_machine_run();

 #endif // STATE_MACHINE_H
 
```

## src/threads.c
```c
/*
Source file to define threads
*/

#include "threads.h"
```

## src/threads.h
```c
/*
Header to define threads
*/

#ifndef THREADS_H
#define THREADS_H

#include "includes.h"

#endif
```
