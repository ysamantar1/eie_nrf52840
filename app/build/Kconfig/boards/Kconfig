## app/build/Kconfig/boards/Kconfig
```kconfig
# Load Zephyr board Kconfig descriptions.
osource "C:/Users/ysama/zephyr-projects/zephyr/boards/nordic/nrf52840dk/Kconfig"
```

## app/build/Kconfig/boards/Kconfig.defconfig
```kconfig
# Load Zephyr board defconfig descriptions.
osource "C:/Users/ysama/zephyr-projects/zephyr/boards/nordic/nrf52840dk/Kconfig.defconfig"
```

## app/build/Kconfig/boards/Kconfig.nrf52840dk
```kconfig
# Load board Kconfig descriptions.
osource "C:/Users/ysama/zephyr-projects/zephyr/boards/nordic/nrf52840dk/Kconfig.nrf52840dk"
```
